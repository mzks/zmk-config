#include "proto20.dtsi"

&kscan0 {

    col-gpios
        = <&xiao_d 7 (GPIO_ACTIVE_HIGH | GPIO_PULL_DOWN)>
        , <&xiao_d 8 (GPIO_ACTIVE_HIGH | GPIO_PULL_DOWN)>
        , <&xiao_d 9 (GPIO_ACTIVE_HIGH | GPIO_PULL_DOWN)>
        , <&xiao_d 10 (GPIO_ACTIVE_HIGH | GPIO_PULL_DOWN)>
        ;
};

&left_encoder {
    status = "okay";
};
&xiao_spi { status = "disabled"; };
&xiao_serial { status = "disabled"; };
