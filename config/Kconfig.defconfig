## config/Kconfig.defconfig
```kconfig
if SHIELD_PROTO20_LEFT

config ZMK_KEYBOARD_NAME
    default "proto20"
config ZMK_USB
    default y
config ZMK_SPLIT_ROLE_CENTRAL
    default y

endif

if SHIELD_PROTO20_LEFT || SHIELD_PROTO20_RIGHT

config ZMK_SPLIT
    default y

endif
```

## config/boards/shields/mzmacro/Kconfig.defconfig
```kconfig
if SHIELD_MZMACRO

config ZMK_KEYBOARD_NAME
    default "mzmacro"
config ZMK_USB
    default y

endif
```

## config/boards/shields/proto20/Kconfig.defconfig
```kconfig
if SHIELD_PROTO20

config ZMK_KEYBOARD_NAME
    default "proto20"
config ZMK_USB
    default y

endif
```

## config/boards/shields/proto20/Kconfig.shield
```kconfig
config SHIELD_PROTO20_LEFT
    def_bool $(shields_list_contains,proto20_left)

config SHIELD_PROTO20_RIGHT
    def_bool $(shields_list_contains,proto20_right)
```
